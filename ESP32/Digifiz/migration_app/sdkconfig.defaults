## ESP32/Digifiz/migration_app/sdkconfig.defaults
```kconfig
CONFIG_IDF_TARGET="esp32s3"
CONFIG_ESPTOOLPY_FLASHSIZE_8MB=y
CONFIG_PARTITION_TABLE_CUSTOM=y
CONFIG_PARTITION_TABLE_CUSTOM_FILENAME="partitions.csv"
CONFIG_PARTITION_TABLE_FILENAME="partitions.csv"
CONFIG_SPI_FLASH_DANGEROUS_WRITE_ALLOWED=y
CONFIG_SPI_FLASH_WRITING_DANGEROUS_REGIONS_ALLOWED=y
CONFIG_COMPILER_OPTIMIZATION_SIZE=y
```

## ESP32/Digifiz/nvs_wifi_connect/Kconfig.projbuild
```kconfig
menu "Nvs WiFi Connect"

    config DEFAULT_NVS_WIFI_CONNECT_URI
        string "Connect page URI"
        default "/wifi"
        help
            WEB page URI to set ssid/pass.

    config DEFAULT_NVS_WIFI_CONNECT_WS_URI
        string "Connect ws URI"
        default "/wifi/ws"
        help
            WEB ws URI to set ssid/pass.

    config DEFAULT_AP_ESP_WIFI_SSID
        string "Default AP SSID"
        default "Provision_Wifi_AP"
        help
            Default AP SSID for first connect.

    config DEFAULT_AP_ESP_WIFI_PASS
        string "Default AP PASSWORD"
        default ""
        help
            Default AP Password for first connect.

endmenu
```
